## conf/layer.conf
```bitbake
# We have a conf and classes directory, add to BBPATH
BBPATH .= ":${LAYERDIR}"

# We have recipes-* directories, add to BBFILES
BBFILES += "${LAYERDIR}/recipes-*/*/*.bb \
	${LAYERDIR}/recipes-*/*/*.bbappend"

BBFILE_COLLECTIONS += "cetibox_x3-baselevel"
BBFILE_PATTERN_cetibox_x3-baselevel = "^${LAYERDIR}/"
BBFILE_PRIORITY_cetibox_x3-baselevel = "47"
LAYERSERIES_COMPAT_cetibox_x3-baselevel = "zeus"
```
